## fall_detection/build/ipc_radio/Kconfig/Kconfig.shield
```kconfig
osource "/Users/joaovitor/my_boards/boards/shields/*/Kconfig.shield"
osource "/opt/nordic/ncs/v2.9.0/nrf/boards/shields/*/Kconfig.shield"
```

## fall_detection/build/ipc_radio/Kconfig/Kconfig.shield.defconfig
```kconfig
osource "/Users/joaovitor/my_boards/boards/shields/*/Kconfig.defconfig"
osource "/opt/nordic/ncs/v2.9.0/nrf/boards/shields/*/Kconfig.defconfig"
```
