## CMakeLists.txt
```
cmake_minimum_required(VERSION 3.20.0)
find_package(Zephyr REQUIRED HINTS $ENV{ZEPHYR_BASE})

project(fall_detection)

target_sources(app PRIVATE 
    src/main.c
    src/led/led.c
    src/fall_detection/fall_detection.c
    src/BLE/ble_service.c
)

# NORDIC SDK APP END
zephyr_library_include_directories(.)
```

## prj.conf
```kconfig
#   #   #   #   #   #   #   #   #   #   #   #
#   Tiresias Hearing Device Project         # 
#   University of Sao Paulo                 #
#   Author: Joao Victor Colombari Carlet    #
#   #   #   #   #   #   #   #   #   #   #   #

# Logger module
CONFIG_LOG=y

CONFIG_STDOUT_CONSOLE=y
CONFIG_I2C=y
CONFIG_GPIO=y
CONFIG_SENSOR=y
CONFIG_CBPRINTF_FP_SUPPORT=y

CONFIG_SENSOR_LOG_LEVEL_DBG=y
CONFIG_I2C_LOG_LEVEL_DBG=y

# Bluetooth LE
CONFIG_BT=y
CONFIG_BT_PERIPHERAL=y
CONFIG_BT_DEVICE_NAME="fall_Detector"

# Increase stack size for the main thread and System Workqueue
CONFIG_SYSTEM_WORKQUEUE_STACK_SIZE=20480
CONFIG_MAIN_STACK_SIZE=20480
```

## src/main.c
```c
//  //  //  //  //  //  //  //  //  //  //  //
//  Tiresias Hearing Device Project         //
//  University of Sao Paulo                 //
//  Author: Joao Victor Colombari Carlet    //
//  //  //  //  //  //  //  //  //  //  //  //

#include <zephyr/kernel.h>
#include <zephyr/device.h>
#include <zephyr/drivers/sensor.h>
#include <zephyr/devicetree.h>
#include <zephyr/drivers/gpio.h>
#include <zephyr/bluetooth/bluetooth.h>
#include <stdio.h>
#include <math.h>

#include "led/led.h"
#include "fall_detection/fall_detection.h"
#include "BLE/ble_service.h"

/* 
    Semaphore for signaling fall detection:

    Statically define and initialize a semaphore;

    The semaphore can be accessed outside the module where it is defined using:

    extern struct k_sem <name>; 

*/

K_SEM_DEFINE(fall_sem, 0, 1);

/* Main Function */
int main(void) {

    ble_service_init();
    led_init();
    sensor_init();

    printf("Fall Detection System Initialized!\n");

    return 0;
}

/* Define threads */
K_THREAD_DEFINE(ble_tid, 10240, ble_service_thread, NULL, NULL, NULL, 3, 0, 0);
K_THREAD_DEFINE(led_tid, 1024, led_thread, NULL, NULL, NULL, 2, 0, 0);
K_THREAD_DEFINE(fall_tid, 1024, detect_fall_thread, NULL, NULL, NULL, 1, 0, 0);

/* In Zephyr, main thread is priority zero by default, so no need to define it! */
```

## src/fall_detection.c
```c
#include "fall_detection.h"
#include "led.h"

/* Declaracao do semaforo */
extern struct k_sem fall_sem; 

const struct device *dev;

/* Function to calculate total acceleration in m/s2 */
double compute_total_acceleration(struct sensor_value *acc) {
    float ax = acc[0].val1 + acc[0].val2 / 1000000.0;
    float ay = acc[1].val1 + acc[1].val2 / 1000000.0;
    float az = acc[2].val1 + acc[2].val2 / 1000000.0;
    return (double)sqrt(ax * ax + ay * ay + az * az);
}

int sensor_init(void) {
    dev = DEVICE_DT_GET_ONE(bosch_bmi270);
    if (!device_is_ready(dev)) {
        printf("Device %s is not ready\n", dev->name);
        return 0;
    }

    printf("Device %p name is %s\n", dev, dev->name);

     /* Sensor Configuration */
     struct sensor_value full_scale, sampling_freq, oversampling;
        
     /*
         Esse sensor_value e a definicao da estrutura sensor_value e do tipo de valor 
         que as variaveis das instancias dessa estrutura podem assumnir, que no caso
         sao int de 32 bits..
     */
 
     /*
         O full scale sao os valores de fullscale referidos no proprio datasheet, que
         podem ser 2, 4, 8 e 16 G. A API usa uma funcao chamada channel_accel_convert
         para converter para SI.
     */
 
     full_scale.val1 = 2;            /* G */
     full_scale.val2 = 0;
     sampling_freq.val1 = 100;       /* Hz. Performance mode */
     sampling_freq.val2 = 0;
     oversampling.val1 = 1;          /* Normal mode */
     oversampling.val2 = 0;
 
     sensor_attr_set(dev, SENSOR_CHAN_ACCEL_XYZ, SENSOR_ATTR_FULL_SCALE, &full_scale);
     sensor_attr_set(dev, SENSOR_CHAN_ACCEL_XYZ, SENSOR_ATTR_OVERSAMPLING, &oversampling);
     sensor_attr_set(dev, SENSOR_CHAN_ACCEL_XYZ, SENSOR_ATTR_SAMPLING_FREQUENCY, &sampling_freq);
     
     return 0;
}

/* Fall Detection Logic */
void detect_fall_thread(void) {

    // Aqui vou dar o primeiro fetch e esperar ele acentar
    sensor_sample_fetch(dev);
    k_sleep(K_MSEC(1000));

    struct sensor_value acc[3];
    static bool in_free_fall = false;
    static bool felt = false;
    static int64_t fall_start_time = 0;

    while (1) {
        k_sleep(K_MSEC(SAMPLING_PERIOD_MS)); // 10MS for 100Hz
        sensor_sample_fetch(dev);
        sensor_channel_get(dev, SENSOR_CHAN_ACCEL_XYZ, acc);
        
        double total_acc = compute_total_acceleration(acc);
        printf("Acceleration: %.2f m/s2\n", total_acc);

        /* Step 1: Detect Free-Fall */
        if (total_acc < FREE_FALL_THRESHOLD) {
            in_free_fall = true;
            fall_start_time = k_uptime_get();
            printf("[WARNING] Free fall detected!\n");
        }

        /* Step 2: Detect Impact */
        if (in_free_fall && total_acc > IMPACT_THRESHOLD) {
            printf("[ALERT] Impact detected!\n");
            in_free_fall = false;

            /* Step 3: Detect Post-Fall Inactivity */
            int64_t start_time = k_uptime_get();
            while (k_uptime_get() - start_time < INACTIVITY_TIME_MS) {
                k_sleep(K_MSEC(1000)); // espera bastante pra debounce
                sensor_sample_fetch(dev);
                sensor_channel_get(dev, SENSOR_CHAN_ACCEL_XYZ, acc);
                total_acc = compute_total_acceleration(acc);
                if (total_acc > 12) {  // Small movement cancels fall alert
                    printf("[INFO] Movement detected after fall. False alarm.\n");
                    break;
                }
                felt = true;
            }

            if (felt) {
                /* Final Decision: Fall Confirmed */
                printf("[CRITICAL] Fall Detected!!\n");

                k_sem_give(&fall_sem);  // Signal LED thread to turn on LED

                felt = false;  // Reset flag for next cycle
            }
        }
    }
}
```

## src/fall_detection.h
```c
#ifndef FALL_DETECTION_H
#define FALL_DETECTION_H

#include <zephyr/kernel.h>
#include <zephyr/device.h>
#include <zephyr/drivers/sensor.h>
#include <zephyr/devicetree.h>
#include <zephyr/drivers/gpio.h>
#include <stdio.h>
#include <math.h>

#define FREE_FALL_THRESHOLD 5.0         // G-force threshold for free-fall detection
#define IMPACT_THRESHOLD 25.0           // G-force threshold for impact detection
#define INACTIVITY_TIME_MS 3000         // Time of inactivity after impact
#define SAMPLING_PERIOD_MS 10           // 100Hz sampling (10ms period)

/* Declaracoes das funcoes */

double compute_total_acceleration(struct sensor_value *acc);

int sensor_init(void);                 

void detect_fall_thread(void);

#endif
```

## src/led.c
```c
#include "led.h"

/* Declaracao do semaforo */
extern struct k_sem fall_sem;

#define LED_NODE DT_ALIAS(led0)
static const struct gpio_dt_spec led = GPIO_DT_SPEC_GET(LED_NODE, gpios);

int led_init(void) {

    if (!device_is_ready(led.port)) {
        return 0;
    }

    gpio_pin_configure_dt(&led, GPIO_OUTPUT_INACTIVE);

    return 0;
}

void led_thread(void) {

    while (1) {
        k_sem_take(&fall_sem, K_FOREVER);  // Wait until a fall is detected
        gpio_pin_set_dt(&led, 1);
        k_sleep(K_SECONDS(5));  // Keep LED on for 5 seconds
        gpio_pin_set_dt(&led, 0);
    }
}
```

## src/led.h
```c
#ifndef LED_H
#define LED_H

#include <zephyr/kernel.h>
#include <zephyr/device.h>
#include <zephyr/drivers/gpio.h>

/* Declaracoes das funcoes */

int led_init(void);

void led_thread(void);

#endif
```
